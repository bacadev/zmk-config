## config/west.yml
```yaml
manifest:
  remotes:
    - name: urob
      url-base: https://github.com/urob
  projects:
    - name: zmk
      remote: urob
      revision: c957348e6187ffde3c073e8c367a60a7ee16b12c
      import: app/west.yml
  self:
    path: config
```
